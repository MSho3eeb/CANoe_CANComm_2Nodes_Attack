VERSION ""

NS_ :

BS_:

BU_: Reciever Sender
VAL_TABLE_ WarningVal 1 "Warning" 0 "NoWarning" ;

BO_ 0 FloodMSG: 8 Sender
 SG_ FLOOD : 0|12@1+ (1,0) [0|4095] "" Vector__XXX

BO_ 102 TempAck: 1 Vector__XXX
 SG_ TempSignal : 0|8@1- (1,0) [0|0] ""  Reciever

BO_ 85 Temp: 1 Sender
 SG_ TempSignal : 0|8@1- (1,0) [0|0] "" Vector__XXX

BO_ 68 SpeedAck: 1 Vector__XXX
 SG_ Speed : 0|8@1+ (1,0) [0|255] ""  Reciever

BO_ 51 Speed: 8 Sender
 SG_ Speed : 0|8@1+ (1,0) [0|255] "" Vector__XXX

BO_ 2 WarnAck: 1 Vector__XXX
 SG_ WarningSignal : 0|1@1+ (1,0) [0|1] ""  Reciever

BO_ 1 WarningMsg: 1 Sender
 SG_ WarningSignal : 0|1@1+ (1,0) [0|1] "" Vector__XXX

BA_DEF_  "BusType" STRING ;
BA_DEF_DEF_  "BusType" "CAN";
VAL_ 2 WarningSignal 1 "Warning" 0 "NoWarning" ;
VAL_ 1 WarningSignal 1 "Warning" 0 "NoWarning" ;
